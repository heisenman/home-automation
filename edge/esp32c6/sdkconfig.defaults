## edge/esp32c6/sdkconfig.defaults
```kconfig
# Defaults applied on first `idf.py set-target esp32c6`. Edit sdkconfig (not this) for local tweaks.

CONFIG_IDF_TARGET="esp32c6"

# ── Bluetooth: NimBLE — observer (passive scan) + central (GATT history pull) ──
CONFIG_BT_ENABLED=y
CONFIG_BT_NIMBLE_ENABLED=y
CONFIG_BT_NIMBLE_ROLE_OBSERVER=y
CONFIG_BT_NIMBLE_ROLE_CENTRAL=y
# (peripheral/broadcaster left off — we only scan and connect-out)
# Host task builds history-relay JSON payloads on its stack during a pull:
CONFIG_BT_NIMBLE_HOST_TASK_STACK_SIZE=6144

# ── Wi-Fi + BT share the single 2.4 GHz radio: enable SW coexistence ───────────
CONFIG_ESP_COEX_SW_COEXIST_ENABLE=y

# ── Flash: ESP32-C6FH4 has 4MB embedded flash (needed for two 1.75MB OTA slots) ──
CONFIG_ESPTOOLPY_FLASHSIZE_4MB=y
CONFIG_ESPTOOLPY_FLASHSIZE="4MB"

# ── Partition table: custom A/B OTA layout ───────────────────────────────────────
CONFIG_PARTITION_TABLE_CUSTOM=y
CONFIG_PARTITION_TABLE_CUSTOM_FILENAME="partitions.csv"

# ── OTA rollback: bootloader auto-reverts to the last-good slot if a freshly-OTA'd ──
# app fails its self-test (it must call esp_ota_mark_app_valid_cancel_rollback()). Cable-
# flashed images are never in pending-verify state, so this is harmless for bench dev.
CONFIG_BOOTLOADER_APP_ROLLBACK_ENABLE=y
# OTA delivery is HTTP pull from the local server (cleartext on the LAN; air-gapped, no TLS).
CONFIG_ESP_HTTPS_OTA_ALLOW_HTTP=y

# ── Misc ────────────────────────────────────────────────────────────────────────
CONFIG_LOG_DEFAULT_LEVEL_INFO=y
CONFIG_ESP_MAIN_TASK_STACK_SIZE=6144
```

## provisioning/reterminal/beachhead/sdkconfig.defaults
```kconfig
# === D1001 beachhead defaults ===
CONFIG_IDF_TARGET="esp32p4"

# PSRAM — P4 relies on it for WiFi/LWIP buffers (from Seeed factory defaults)
CONFIG_SPIRAM=y
# NB: on P4, SPIRAM_SPEED_200M depends on IDF_EXPERIMENTAL_FEATURES — WITHOUT the
# experimental flag Kconfig silently drops to the 20MHz default (too slow to scan
# out the 800x1280 DPI framebuffer). The Seeed BSP enables it; we must too.
CONFIG_IDF_EXPERIMENTAL_FEATURES=y
CONFIG_SPIRAM_SPEED_200M=y
CONFIG_SPIRAM_USE_MALLOC=y
CONFIG_SPIRAM_TRY_ALLOCATE_WIFI_LWIP=y
CONFIG_SPIRAM_MALLOC_RESERVE_INTERNAL=32768

# esp-hosted: keep the SDIO transport buffer pool + hosted task stacks in
# (DMA-capable) PSRAM. Linking the LVGL/display stack grows internal .bss and was
# starving internal DRAM, so sdio_mempool_create() OOM'd -> boot-loop panic.
# P4 GDMA reaches PSRAM, so the SDIO pool works fine there.
CONFIG_ESP_HOSTED_MEMPOOL_PREFER_SPIRAM=y
CONFIG_ESP_HOSTED_DFLT_TASK_FROM_SPIRAM=y

# 32 MB flash, QIO
CONFIG_ESPTOOLPY_FLASHSIZE_32MB=y
CONFIG_ESPTOOLPY_FLASHMODE_QIO=y

# OTA-ready custom partition table
CONFIG_PARTITION_TABLE_CUSTOM=y
CONFIG_PARTITION_TABLE_CUSTOM_FILENAME="partitions.csv"

# === esp-hosted: ESP32-C6 WiFi coprocessor over SDIO ===
# Pin map + reset copied verbatim from Seeed's factory_firmware/sdkconfig.defaults
CONFIG_SLAVE_IDF_TARGET_ESP32C6=y
CONFIG_ESP_HOSTED_SDIO_GPIO_RESET_SLAVE=13
CONFIG_ESP_HOSTED_PRIV_SDIO_PIN_CLK_SLOT_1=11
CONFIG_ESP_HOSTED_PRIV_SDIO_PIN_CMD_SLOT_1=6
CONFIG_ESP_HOSTED_PRIV_SDIO_PIN_D0_SLOT_1=7
CONFIG_ESP_HOSTED_PRIV_SDIO_PIN_D1_4BIT_BUS_SLOT_1=8
CONFIG_ESP_HOSTED_PRIV_SDIO_PIN_D2_4BIT_BUS_SLOT_1=9
CONFIG_ESP_HOSTED_PRIV_SDIO_PIN_D3_4BIT_BUS_SLOT_1=10

CONFIG_LOG_DEFAULT_LEVEL_INFO=y

# Allow plain-HTTP OTA (trusted LAN dev). Production hardening later = signed images / TLS.
CONFIG_ESP_HTTPS_OTA_ALLOW_HTTP=y

# === Phase 2 display (LVGL + MIPI-DSI) ===
# LVGL renders RGB565 to match the JD9365 DPI panel; draw buffers live in PSRAM.
CONFIG_LV_COLOR_DEPTH_16=y
CONFIG_LV_MEM_SIZE_KILOBYTES=64
# Fonts for the tile UI (headline values + titles); default is 14 only.
CONFIG_LV_FONT_MONTSERRAT_20=y
CONFIG_LV_FONT_MONTSERRAT_28=y
# NB: do NOT force SPIRAM_MALLOC_ALWAYSINTERNAL — it starves internal DRAM during
# WiFi/esp-hosted bring-up (crashes before WiFi connects). The DPI panel already
# allocates its framebuffer from PSRAM; RESERVE_INTERNAL=32768 keeps DMA headroom.

# === OTA safety: roll back automatically on a bad image ===
# App boots PENDING_VERIFY; esp_ota_mark_app_valid runs on MQTT connect. If a
# future OTA never reaches MQTT, the bootloader reverts to the last good slot.
# (Takes effect via this full USB reflash, which rewrites the bootloader.)
CONFIG_BOOTLOADER_APP_ROLLBACK_ENABLE=y

# === Spike 0 (ADR-0019 Phase 6): NimBLE host-only over esp-hosted VHCI ===
# The P4 has NO native BT controller (SOC_BT_SUPPORTED=n) — BT_ENABLED is gated on
# !APP_NO_BLOBS in IDF v5.4, so the host-only NimBLE stack DOES build on the P4.
# The controller lives on the C6 slave; HCI rides the esp-hosted SDIO link as VHCI.
# Config lifted verbatim from esp_hosted example host_nimble_bleprph_host_only_vhci.
CONFIG_BT_ENABLED=y
CONFIG_BT_CONTROLLER_DISABLED=y
CONFIG_BT_BLUEDROID_ENABLED=n
CONFIG_BT_NIMBLE_ENABLED=y
CONFIG_BT_NIMBLE_TRANSPORT_UART=n
CONFIG_ESP_HOSTED_ENABLE_BT_NIMBLE=y
CONFIG_ESP_HOSTED_NIMBLE_HCI_VHCI=y
# NimBLE/VHCI controller timing wants the 1 kHz tick (the example sets this). Note:
# this is a global tick change on top of the working display/wifi/OTA firmware.
CONFIG_FREERTOS_HZ=1000
```
