## firmware/components/ha_gatt_exec/Kconfig
```kconfig
menu "ha_gatt_exec"

config HA_GATT_ALLOW_WRITE
    bool "Allow arbitrary GATT writes (actuation)"
    default n
    help
        Arbitrary GATT characteristic writes are an ACTUATION primitive: a validly-signed command
        could otherwise drive any BLE device's characteristics. A telemetry-only relay never needs
        them (sub/read/collect suffice; the CCCD notify-enable in a "sub" step is not arbitrary
        actuation). Least privilege: leave this OFF (n) so the write path is not even compiled into
        the image. Set it to y ONLY in a per-actuator firmware build's sdkconfig.defaults.

endmenu
```

## firmware/components/ha_mqtt/Kconfig
```kconfig
menu "ha_mqtt (edge control plane)"

config HA_MQTT_NO_BLE
    bool "Build ha_mqtt without BLE (contact-driving nodes)"
    default n
    help
      Drop ha_mqtt's BLE dependencies (ha_gatt, ha_gatt_exec, ha_ble_scan — all of which REQUIRE `bt`)
      and compile out the BLE-only command ops (history, gatt, batt_refresh) plus the OTA radio-pause
      seam.

      Enable this on a node that drives contacts rather than scanning — ADR-0041's ha-shades and ha-hvac.
      Such a node still needs this component's signed-command gate (ADR-0010), OTA path and publish
      topics, but linking the whole NimBLE stack for a radio role it does not have is both wasteful and
      a lie about what the node is.

      Deliberately default n, so every existing BLE relay build is byte-identical.

endmenu
```
